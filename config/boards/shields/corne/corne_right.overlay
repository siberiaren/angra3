// #include "corne.dtsi" // Same note as above for corne_left.overlay

/ {
    chosen {
        zmk,kscan = &kscan0;
    };

    kscan0: kscan { // Explicitly define the kscan0 node here
        compatible = "zmk,kscan-gpio-matrix";
        diode-direction = "col2row"; // IMPORTANT: Verify your diode direction!

        col-gpios =
            // Right half columns (using nice!nano_v2 (nRF52840) pin numbers)
            <&gpio0 6 GPIO_ACTIVE_HIGH>,
            <&gpio0 7 GPIO_ACTIVE_HIGH>,
            <&gpio0 15 GPIO_ACTIVE_HIGH>,
            <&gpio0 16 GPIO_ACTIVE_HIGH>,
            <&gpio0 9 GPIO_ACTIVE_HIGH>,
            <&gpio0 14 GPIO_ACTIVE_HIGH>,
            <&gpio0 20 GPIO_ACTIVE_HIGH>
        ;

        row-gpios =
            // Right half rows (using nice!nano_v2 (nRF52840) pin numbers)
            <&gpio0 5 (GPIO_ACTIVE_HIGH | GPIO_PULL_DOWN)>,
            <&gpio0 8 (GPIO_ACTIVE_HIGH | GPIO_PULL_DOWN)>,
            <&gpio0 10 (GPIO_ACTIVE_HIGH | GPIO_PULL_DOWN)>,
            <&gpio0 18 (GPIO_ACTIVE_HIGH | GPIO_PULL_DOWN)>,
            <&gpio0 19 (GPIO_ACTIVE_HIGH | GPIO_PULL_DOWN)>
        ;
    };
};
