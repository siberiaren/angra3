// #include "corne.dtsi" // You can remove this line if corne.dtsi only contains optional features,
                        // or if it's causing conflicts. If it defines other necessary components
                        // for your shield, you might keep it, but ensure it doesn't conflict
                        // with the kscan0 definition below.
                        // For a clean start, try removing it first if you're only defining pins.

/ {
    chosen {
        zmk,kscan = &kscan0;
    };

    kscan0: kscan { // Explicitly define the kscan0 node here
        compatible = "zmk,kscan-gpio-matrix";
        diode-direction = "col2row"; // IMPORTANT: Verify your diode direction!

        col-gpios =
            // Left half columns (using nice!nano_v2 (nRF52840) pin numbers)
            <&gpio0 21 GPIO_ACTIVE_HIGH>,
            <&gpio0 10 GPIO_ACTIVE_HIGH>,
            <&gpio0 16 GPIO_ACTIVE_HIGH>,
            <&gpio0 14 GPIO_ACTIVE_HIGH>,
            <&gpio0 20 GPIO_ACTIVE_HIGH>,
            <&gpio0 19 GPIO_ACTIVE_HIGH>,
            <&gpio0 6 GPIO_ACTIVE_HIGH>
        ;

        row-gpios =
            // Left half rows (using nice!nano_v2 (nRF52840) pin numbers)
            <&gpio0 4 (GPIO_ACTIVE_HIGH | GPIO_PULL_DOWN)>,
            <&gpio0 15 (GPIO_ACTIVE_HIGH | GPIO_PULL_DOWN)>,
            <&gpio0 9 (GPIO_ACTIVE_HIGH | GPIO_PULL_DOWN)>,
            <&gpio0 8 (GPIO_ACTIVE_HIGH | GPIO_PULL_DOWN)>,
            <&gpio0 7 (GPIO_ACTIVE_HIGH | GPIO_PULL_DOWN)>
        ;
    };
};
